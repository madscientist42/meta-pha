## conf/distro/pha-linux.conf
```bitbake
# We're derived from Poky, with a couple of mods...
require conf/distro/poky.conf
DISTRO = "pha-linux"
DISTROOVERRIDES = "poky"

LOCALCONF_VERSION = "2"

# Force runit instead of sysvinit, carve a few other things out.
DISTRO_FEATURES:remove = " sysvinit"
DISTRO_FEATURES:remove = " nfc"
DISTRO_FEATURES:remove = " 3g"
DISTRO_FEATURES:append = " runit runit-init socklogd wifi bluetooth x11 opengl pam"
VIRTUAL-RUNTIME_init_manager = "runit"
VIRTUAL-RUNTIME_initscripts = "runit-base-services"

# Add a few additional Host based tools to the supported list...
HOSTTOOLS += "bc rsync whoami bison yacc"
```

## conf/layer.conf
```bitbake
# We have a conf and classes directory, append to BBPATH
BBPATH .= ":${LAYERDIR}"

# We have a recipes directory, add to BBFILES
BBFILES += "${LAYERDIR}/recipes*/*/*.bb ${LAYERDIR}/recipes*/*/*.bbappend"

BBFILE_COLLECTIONS += "meta-pha"
BBFILE_PATTERN_meta-pha := "^${LAYERDIR}/"
BBFILE_PRIORITY_meta-pha = "6"

LICENSE_PATH += "${LAYERDIR}/licenses"

# We keep at least one or two of the LTSes active, plus whatever latest thing (As needed) and the
# stuff I have to support as an upstream.  The LTSes and the latest are a given, others
# may not be.  If you need an EOLed version of Yocto supported, we can help as long as
# you provide help on your end, whatever form that takes (Warm bodies, cash, rare booze, etc.).
LAYERVERSION_meta-pha = "1"
LAYERDEPENDS_meta-pha = "core"
LAYERSERIES_COMPAT_meta-pha = "kirkstone nanbield"

# Recipe modifications for other layers that may be included in the build as
# we supply mods for more than just the core here.  meta-efl, etc. joins in
# on the fun so we have this handled in one tidy package instead of several
# spread out layersets.
BBFILES += "${@' '.join('${LAYERDIR}/external/%s/recipes*/*/*.bb' % layer \
               for layer in BBFILE_COLLECTIONS.split() if os.path.exists(os.path.join('${LAYERDIR}','external',layer)))}"
BBFILES += "${@' '.join('${LAYERDIR}/external/%s/recipes*/*/*.bbappend' % layer \
               for layer in BBFILE_COLLECTIONS.split() if os.path.exists(os.path.join('${LAYERDIR}','external',layer)))}"
```

## conf/machine/nanopi-neo-plus2.conf
```bitbake
#@TYPE: Machine
#@NAME: nanopi-neo2-plus
#@DESCRIPTION: Machine configuration for the FriendlyARM NanoPi Neo2-Plus, based on the Allwinner H5 CPU

PREFERRED_VERSION_u-boot = "v2018.03%"
PREFERRED_VERSION_linux-mainline = "4.16%"

# Setting aside some explicit breadcrumbs to build a "correct" image...
KERNEL_BOOTCMD ??= "bootm"
KERNEL_IMAGETYPE_UBOOT ??= "uImage"
KERNEL_IMAGETYPE ?= "${@bb.utils.contains('RPI_USE_U_BOOT', '1', '${KERNEL_IMAGETYPE_UBOOT}', 'Image', d)}"
KERNEL_DEVICETREE = "allwinner/sun50i-h5-nanopi-neo-plus2.dtb"

UBOOT_MACHINE = "nanopi_neo_plus2_defconfig"

# We're a 50i configuration (64-bits, etc...)
require conf/machine/include/sun50i.inc
```

## conf/machine/nanopi-neo2-64.conf
```bitbake
#@TYPE: Machine
#@NAME: nanopi-neo2
#@DESCRIPTION: Machine configuration for the FriendlyARM NanoPi Neo2, based on the Allwinner H5 CPU

# We're going to jump to 64-bits...
require conf/machine/include/sun50i.inc

PREFERRED_VERSION_u-boot = "v2017.11%"

KERNEL_DEVICETREE = "sun50i-h5-nanopi-neo2.dtb"
UBOOT_MACHINE = "nanopi_neo2_defconfig"

DEFAULTTUNE = "cortexa7hf-neon-vfpv4"
```

## conf/machine/nanopi-neo2.conf
```bitbake
#@TYPE: Machine
#@NAME: nanopi-neo2
#@DESCRIPTION: Machine configuration for the FriendlyARM NanoPi Neo2, based on the Allwinner H5 CPU

PREFERRED_VERSION_u-boot = "v2018.03%"
PREFERRED_VERSION_linux-mainline = "4.16%"

# Setting aside some explicit breadcrumbs to build a "correct" image...
KERNEL_BOOTCMD ??= "bootm"
KERNEL_IMAGETYPE_UBOOT ??= "uImage"
KERNEL_IMAGETYPE ?= "${@bb.utils.contains('RPI_USE_U_BOOT', '1', '${KERNEL_IMAGETYPE_UBOOT}', 'Image', d)}"
KERNEL_DEVICETREE = "allwinner/sun50i-h5-nanopi-neo2.dtb"

# We use the U-Boot defconfig in the upstream we're specifying right now.
UBOOT_MACHINE = "nanopi_neo2_defconfig"

# We're a 50i configuration (64-bits, etc...)
require conf/machine/include/sun50i.inc
```

## conf/machine/pha-pynq-z2.conf
```bitbake
# Custom config file for a Pynq-Z2 that handles our specific details outsider
# of the Pynq ecosystem...
require conf/machine/zynq-generic.conf

# We want/need to handle the FPGA image details at OS load time instead of
# in the boot.bin file- can't do device upgrades with Uptane or similar via
# the meta-updater layer...it places it into an area that can't safely BE
# OTA updated, the Boot partition which has nothing ping-pong OR ostree there
# to work with.
MACHINE_FEATURES += "fpga-overlay"

# Make a generic class that sits in MACHINEOVERIDES for this.
MACHINEOVERIDES .= ":pha-pynq"

# Now, nerf a few things Xilinx thought were..."useful"...for a Yocto
# build for their targets.  In the large, it's **NOT** so to do an initramfs
# only build for a rootfs.  VERY limiting.  You need to be able to specify
# it but unless you dig a bit to do this, you're not going to have *FUN*
# trying to do a larger system codebase on target and it makes it...difficult...
# to do system updates.  C'mon Xilinx...quit doing silly things like this
# just to provide, "support," and sell Petalinux seats.  It's unprofessional.
IMAGE_FSTYPES:remove = "cpio"
IMAGE_FSTYPES:remove = "cpio.gz"
IMAGE_FSTYPES:remove = "cpio.gz.u-boot"
IMAGE_FSTYPES += "wic"
WKS_FILE = "xilinx-default-sd.wks"
```
